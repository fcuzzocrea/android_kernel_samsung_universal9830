## arch/arm64/configs/exynos9830-c1slte_defconfig
```kconfig
CONFIG_BCM4375=y
CONFIG_BT_BCM43XX=y
CONFIG_CAMERA_CIS_2LA_OBJ=y
CONFIG_CAMERA_CIS_2LD_OBJ=y
CONFIG_CAMERA_CIS_3J1_OBJ=y
CONFIG_CAMERA_CIS_GW2_OBJ=y
CONFIG_CAMERA_CNT_V01=y
CONFIG_CAMERA_FLASH_S2MPB02_OBJ=y
CONFIG_EPEN_WACOM_W9020=y
CONFIG_EXTEND_LIVE_CLOCK=y
CONFIG_EXYNOS_DECON_LCD_COPR=y
CONFIG_EXYNOS_DECON_LCD_S6E3FA9=y
CONFIG_EXYNOS_DECON_LCD_S6E3FAB=y
CONFIG_EXYNOS_DECON_LCD_S6E3HAB=y
CONFIG_INPUT_WACOM=y
CONFIG_LEDS_S2MPB02=y
CONFIG_MODEL_C1SLTE=y
CONFIG_MOTOR_CS40L2X=y
CONFIG_MOTOR_DRV_MAX77705=y
CONFIG_NAD_55=y
CONFIG_NFC_FEATURE_SN100U=y
CONFIG_NFC_PN547=y
CONFIG_NFC_PN547_ESE_SUPPORT=y
CONFIG_PD_CHARGER_HV_DISABLE=y
CONFIG_SEC_BPS_INFO_ADD=y
CONFIG_SEC_HAPTIC=y
CONFIG_SEC_NAD_API=y
CONFIG_SEC_NAD_PMIC=y
CONFIG_SEC_SUPPORT_MOTTOTEST_WITH_ACT=y
CONFIG_SENSORS_A96T365IF=y
CONFIG_SENSORS_A96T3X6=y
CONFIG_SENSORS_A96T3X6_BLOCK_SAR_ONLY=y
CONFIG_SENSORS_A96T3X6_CRC_CHECK=y
CONFIG_SENSORS_DYNAMIC_SENSORLIST=y
CONFIG_SENSORS_FW_VENDOR=y
CONFIG_SENSORS_QBT2000=y
CONFIG_SENSORS_SSP_CANVAS=y
CONFIG_SENSORS_SX9360=y
CONFIG_SENSOR_RETENTION_USE=y
CONFIG_SUPPORT_CCD_TEST=y
CONFIG_SUPPORT_DDI_FLASH=y
CONFIG_SUPPORT_DISPLAY_PROFILER=y
CONFIG_SUPPORT_FAST_DISCHARGE=y
CONFIG_SUPPORT_POC_FLASH=y
CONFIG_SUPPORT_POC_SPI=y
CONFIG_TOUCHSCREEN_SEC_TS_Y79A_C=y
CONFIG_USE_OIS_TAMODE_CONTROL=y
CONFIG_WIRELESS_CHARGER_HAL_MFC=y
CONFIG_WIRELESS_CHARGER_MFC_S2MIW04=y
CONFIG_WLAN_BCM4375_ADVANCED_FEATURES=y
CONFIG_WLAN_TSQ_MULTIPLIER=y
CONFIG_WLAN_VENDOR_DUMP_ENABLE=y
```

## arch/arm64/configs/exynos9830-z3sxxx_defconfig
```kconfig
CONFIG_BCM4375=y
CONFIG_BT_BCM43XX=y
CONFIG_CAMERA_CIS_2L3_OBJ=y
CONFIG_CAMERA_CIS_GH1_OBJ=y
CONFIG_CAMERA_CIS_HM1_OBJ=y
CONFIG_CAMERA_CIS_IMX516_OBJ=y
CONFIG_CAMERA_CIS_IMX518_OBJ=y
CONFIG_CAMERA_CIS_IMX586_OBJ=y
CONFIG_CAMERA_CIS_TOF_BUCK_USE=y
CONFIG_CAMERA_FLASH_S2MPB02_OBJ=y
CONFIG_CAMERA_HST_V03=y
CONFIG_DECON_BTS_VRR_ASYNC=y
CONFIG_ESE_COLDRESET=y
CONFIG_ESE_P3_LSI=y
CONFIG_EXTEND_LIVE_CLOCK=y
CONFIG_EXYNOS_DECON_LCD_COPR=y
CONFIG_EXYNOS_DECON_LCD_S6E3HAB=y
CONFIG_EXYNOS_MULTIRESOLUTION=y
CONFIG_EXYNOS_WINDOW_UPDATE=y
CONFIG_LEDS_S2MPB02=y
CONFIG_MODEL_Z3S=y
CONFIG_MOTOR_CS40L2X=y
CONFIG_PANEL_BACKLIGHT_PAC_3_0=y
CONFIG_PANEL_DISPLAY_MODE=y
CONFIG_PANEL_VRR_BRIDGE=y
CONFIG_PD_CHARGER_HV_DISABLE=y
CONFIG_SEC_NFC=y
CONFIG_SENSORS_A96T365IF=y
CONFIG_SENSORS_A96T3X6=y
CONFIG_SENSORS_A96T3X6_BLOCK_SAR_ONLY=y
CONFIG_SENSORS_A96T3X6_CRC_CHECK=y
CONFIG_SENSORS_FW_VENDOR=y
CONFIG_SENSORS_QBT2000=y
CONFIG_SENSORS_SSP_LIGHT_COLORID=y
CONFIG_SENSORS_SSP_LPS22H=y
CONFIG_SENSORS_SSP_LSM6DSO=y
CONFIG_SENSORS_SSP_MAGNETIC_COMMON=y
CONFIG_SENSORS_SSP_PICASSO=y
CONFIG_SENSORS_SSP_PROX_AUTOCAL_AMS=y
CONFIG_SENSORS_SSP_TMD4907=y
CONFIG_SENSORS_SX9360=y
CONFIG_SUPPORT_CCD_TEST=y
CONFIG_SUPPORT_DDI_FLASH=y
CONFIG_SUPPORT_DIM_FLASH=y
CONFIG_SUPPORT_DISPLAY_PROFILER=y
CONFIG_SUPPORT_DSU=y
CONFIG_SUPPORT_GRAM_CHECKSUM=y
CONFIG_SUPPORT_HMD=y
CONFIG_SUPPORT_MAFPC=y
CONFIG_SUPPORT_POC_FLASH=y
CONFIG_SUPPORT_POC_SPI=y
CONFIG_TOUCHSCREEN_SEC_TS_Y79A=y
CONFIG_WIRELESS_CHARGER_HAL_MFC=y
CONFIG_WIRELESS_CHARGER_MFC_S2MIW04=y
CONFIG_WLAN_SOFTAP_HE_ENABLE=y
CONFIG_WLAN_TSQ_MULTIPLIER=y
CONFIG_WLAN_VENDOR_DUMP_ENABLE=y
```
